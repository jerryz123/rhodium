## sw/buildroot-riscv/configs/linux_smoke_defconfig
```kconfig
# Builds a static init and embedded initramfs; target ISA fields are supplied by the builder.
# SPDX-License-Identifier: Apache-2.0
BR2_riscv=y
BR2_RISCV_64=y
BR2_RISCV_USE_MMU=y
BR2_TOOLCHAIN_BUILDROOT_MUSL=y
BR2_KERNEL_HEADERS_AS_KERNEL=y
BR2_PACKAGE_HOST_LINUX_HEADERS_CUSTOM_6_18=y
BR2_STATIC_LIBS=y
BR2_REPRODUCIBLE=y
BR2_DOWNLOAD_FORCE_CHECK_HASHES=y
BR2_GLOBAL_PATCH_DIR="$(BR2_EXTERNAL_RHODIUM_PATH)/patches"
BR2_INIT_NONE=y
# BR2_PACKAGE_BUSYBOX is not set
# BR2_TARGET_GENERIC_GETTY is not set
BR2_SYSTEM_BIN_SH_NONE=y
BR2_ROOTFS_DEVICE_CREATION_STATIC=y
BR2_ROOTFS_STATIC_DEVICE_TABLE="$(BR2_EXTERNAL_RHODIUM_PATH)/devices.txt"
BR2_PACKAGE_RHODIUM_INIT=y
BR2_LINUX_KERNEL=y
BR2_LINUX_KERNEL_CUSTOM_VERSION=y
BR2_LINUX_KERNEL_CUSTOM_VERSION_VALUE="6.18.7"
BR2_LINUX_KERNEL_USE_CUSTOM_CONFIG=y
BR2_LINUX_KERNEL_CUSTOM_CONFIG_FILE="$(BR2_EXTERNAL_RHODIUM_PATH)/linux.config"
BR2_LINUX_KERNEL_IMAGE=y
BR2_TARGET_ROOTFS_INITRAMFS=y
# BR2_TARGET_ROOTFS_TAR is not set
```
